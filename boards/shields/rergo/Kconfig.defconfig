## boards/shields/rergo/Kconfig.defconfig
```kconfig
if SHIELD_RERGO_LEFT

config ZMK_KEYBOARD_NAME
    default "rergo v3"

config ZMK_SPLIT_BLE_ROLE_CENTRAL
    default y

endif

if SHIELD_RERGO_LEFT || SHIELD_RERGO_RIGHT

config ZMK_SPLIT
    default y

endif
```

## boards/shields/rergo/Kconfig.shield
```kconfig
config SHIELD_RERGO_LEFT
    def_bool $(shields_list_contains,rergo_left)

config SHIELD_RERGO_RIGHT
    def_bool $(shields_list_contains,rergo_right)
```

## config/boards/shields/rergo/Kconfig.defconfig
```kconfig
if SHIELD_RERGO_LEFT

config ZMK_KEYBOARD_NAME
    default "rergo"

config ZMK_SPLIT_BLE_ROLE_CENTRAL
    default y

endif

if SHIELD_RERGO_RIGHT

config ZMK_KEYBOARD_NAME
    default "rergo_right"


endif

if SHIELD_RERGO_LEFT || SHIELD_RERGO_RIGHT

config ZMK_SPLIT
    default y

endif
```
